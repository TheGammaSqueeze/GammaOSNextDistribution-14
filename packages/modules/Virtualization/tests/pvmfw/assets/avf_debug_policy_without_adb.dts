/dts-v1/;
/plugin/;

/ {
    fragment@avf {
        target-path = "/";

        __overlay__ {
            avf {
                guest {
                    microdroid {
                        adb = <0>;
                    };
                };
            };
        };
    };
};